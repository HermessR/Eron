; ============================================================================
; TRACE32 CMM Flash Script
; Generated by: Automation Integration Test Tool (AITT)
; Timestamp:    2026-03-06 14:36:16
; Target:       Cortex-R5 Safety MCU
; CPU:          CortexR5
; Modules:      1
; Session ID:   b8a455d3-5137-4bfd-87dd-d81c1f1135c2
; ============================================================================

; ---------------------------------------------------------------------------
; System Initialization
; ---------------------------------------------------------------------------

SYStem.RESet
SYStem.CPU CortexR5
SYStem.CONFIG.DEBUGPORTTYPE JTAG
SYStem.Up

; Wait for system to stabilize
WAIT 100.ms

; ---------------------------------------------------------------------------
; Flash Configuration
; ---------------------------------------------------------------------------

FLASH.RESet

; Define flash region
FLASH.Create 1. 0x08000000--0x081FFFFF 0x1000 TARGET Long

; Set flash programming target RAM
FLASH.TARGET 0x20000000 0x20002000 0x1000 ~~/demo/arm/flash/long/

; ---------------------------------------------------------------------------
; Module 1/1: comm_stack_arinc429_v1.5.2
; ---------------------------------------------------------------------------

PRINT "Flashing module 1/1: comm_stack_arinc429_v1.5.2"
PRINT "  File:    comm_stack_arinc429_v1.5.2.bin"
PRINT "  Address: 0x08000000"
PRINT "  Size:    24 KB"

; Load firmware data
Data.LOAD.Binary "C:/Users/THINKPAD/Desktop/Eron/aitt/samples/firmware/comm_stack_arinc429_v1.5.2.bin" 0x08000000

; Program flash memory
FLASH.ReProgram ALL
Data.LOAD.Binary "C:/Users/THINKPAD/Desktop/Eron/aitt/samples/firmware/comm_stack_arinc429_v1.5.2.bin" 0x08000000
FLASH.ReProgram OFF

PRINT "Module 1/1 flashed successfully"

; ---------------------------------------------------------------------------
; Verification
; ---------------------------------------------------------------------------

PRINT "Verifying flash contents..."

; Verify comm_stack_arinc429_v1.5.2
Data.LOAD.Binary "C:/Users/THINKPAD/Desktop/Eron/aitt/samples/firmware/comm_stack_arinc429_v1.5.2.bin" 0x08000000 /ComPare
IF FOUND()
(
  PRINT "ERROR: Verification failed for comm_stack_arinc429_v1.5.2"
  ENDDO
)
PRINT "Verified: comm_stack_arinc429_v1.5.2"

; ---------------------------------------------------------------------------
; Completion
; ---------------------------------------------------------------------------

PRINT ""
PRINT "============================================"
PRINT "  FLASHING COMPLETED SUCCESSFULLY"
PRINT "============================================"
PRINT ""

; Reset and run
; SYStem.Up
; Go

ENDDO
