; ============================================================================
; TRACE32 CMM Flash Script
; Generated by: Automation Integration Test Tool (AITT)
; Timestamp:    2026-03-07 00:18:24
; Target:       Custom Target
; CPU:          ARM
; Modules:      1
; Session ID:   84a104e4-9160-4818-bb49-4606825fb6b4
; ============================================================================

; ---------------------------------------------------------------------------
; System Initialization
; ---------------------------------------------------------------------------

SYStem.RESet
SYStem.CPU ARM
SYStem.CONFIG.DEBUGPORTTYPE JTAG
SYStem.Up

; Wait for system to stabilize
WAIT 100.ms

; ---------------------------------------------------------------------------
; Flash Configuration
; ---------------------------------------------------------------------------

FLASH.RESet

; Define flash region
FLASH.Create 1. 0x00000000--0xFFFFFFFE 0x1000 TARGET Long

; Set flash programming target RAM
FLASH.TARGET 0x20000000 0x20002000 0x1000 ~~/demo/arm/flash/long/

; ---------------------------------------------------------------------------
; Module 1/1: bootloader_v1.2.3
; ---------------------------------------------------------------------------

PRINT "Flashing module 1/1: bootloader_v1.2.3"
PRINT "  File:    bootloader_v1.2.3.bin"
PRINT "  Address: 0x08000000"
PRINT "  Size:    16 KB"

; Load firmware data
Data.LOAD.Binary "C:/Users/THINKPAD/Desktop/Eron/aitt/samples/firmware/bootloader_v1.2.3.bin" 0x08000000

; Program flash memory
FLASH.ReProgram ALL
Data.LOAD.Binary "C:/Users/THINKPAD/Desktop/Eron/aitt/samples/firmware/bootloader_v1.2.3.bin" 0x08000000
FLASH.ReProgram OFF

PRINT "Module 1/1 flashed successfully"

; ---------------------------------------------------------------------------
; Verification
; ---------------------------------------------------------------------------

PRINT "Verifying flash contents..."

; Verify bootloader_v1.2.3
Data.LOAD.Binary "C:/Users/THINKPAD/Desktop/Eron/aitt/samples/firmware/bootloader_v1.2.3.bin" 0x08000000 /ComPare
IF FOUND()
(
  PRINT "ERROR: Verification failed for bootloader_v1.2.3"
  ENDDO
)
PRINT "Verified: bootloader_v1.2.3"

; ---------------------------------------------------------------------------
; Completion
; ---------------------------------------------------------------------------

PRINT ""
PRINT "============================================"
PRINT "  FLASHING COMPLETED SUCCESSFULLY"
PRINT "============================================"
PRINT ""

; Reset and run
; SYStem.Up
; Go

ENDDO
